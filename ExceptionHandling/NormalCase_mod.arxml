AUTOSAR XML
container ContainerA: long_name=BB
container ContainerB: long_name=AA
container ContainerC: long_name=CC
